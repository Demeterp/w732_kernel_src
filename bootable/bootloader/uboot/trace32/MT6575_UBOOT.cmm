;RESET
;SYSTEM.OPTION ENRESET OFF
SYSTEM.CPU CortexA9MPCore
SYSTEM.OPTION ENRESET ON
SYStem.Option ResBreak OFF
SYStem.Option WaitReset ON

;R-T Memory Access
SYSTEM.MULTICORE MEMORYACCESSPORT 1
SYSTEM.MULTICORE DEBUGACCESSPORT 1

;Setting Core debug register access
SYSTEM.MULTICORE COREBASE APB:0x80070000

;Setting PTM
;SYSTEM.MULTICORE ETMBASE APB:0x8007C000

;Setting ETB
;SYSTEM.MULTICORE ETBBASE APB:0x80001000

;Setting TPIU
;SYSTEM.MULTICORE TPIUBASE APB:0x80013000

;Setting Funnel
;SYSTEM.MULTICORE FUNNELBASE APB:0x80014000 
;SYSTEM.MULTICORE ETMFUNNELPORT 0

setup.IMASKHLL ON
setup.IMASKASM ON

wait 100.ms

; set_hw_breakpoint_by_def
; setting attribute of breakpoints
Break.Select Program OnChip
Break.Select Hll OnChip
Break.Select Spot OnChip
Break.Select Read OnChip
Break.Select Write OnChip

; disable DABORT and PABORT breakpoint
tronchip.set dabort off
tronchip.set pabort off
SYStem.Up
;
; board init
;
do MT6575_FPGA_SDR.cmm

print "loading u-boot image"
d.load.elf ../u-boot /gnu

print "loading bootimg image"
;d.load.binary ../boot.img 0x10000000 /word /noclear

Y.SPATH.RESET ; reset all source path
Y.SPATH.SRD ../../../../mediatek/platform/mt6575/uboot
Y.SPATH.SRD ../common
Y.SPATH.SRD ../arch/arm/cpu/arm_cortexa9
Y.SPATH.SRD ../drivers/
Y.SPATH.SRD ../include
Y.SPATH.SRD ../arch/arm/lib
Y.SPATH.SRD ../disk
Y.SPATH.SRD ../fs/fat
Y.SPATH.SRD ../fs/fdos
Y.SPATH.SRD ../lib
Y.SPATH.SRD ../tools

enddo

